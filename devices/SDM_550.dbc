VERSION ""

NS_ :

BS_:

BU_: PLEX

BO_ 1680 SDM_GPS: 8 PLEX
 SG_ GPS_Lat : 7|32@0- (1E-007,0) [0|0] "deg" Vector__XXX
 SG_ GPS_Long : 39|32@0- (1E-007,0) [0|0] "deg" Vector__XXX

VERSION ""

NS_ :

BS_:

BU_: IMU

BO_ 380 IMU_Z: 8 IMU
 SG_ IMU_Z_Accel : 32|16@1+ (0.0001274,-4.1746432) [0|0] "g" Vector__XXX

BO_ 376 IMU_X_Roll: 8 IMU
 SG_ IMU_X_Accel : 32|16@1+ (0.0001274,-4.1746432) [0|0] "g" Vector__XXX
 SG_ IMU_Roll_Rate : 0|16@1+ (0.005,-163.84) [0|0] "deg/s/s" Vector__XXX

BO_ 372 IMU_Y_Yaw: 8 IMU
 SG_ IMU_Y_Accel : 32|16@1+ (0.0001274,-4.1746432) [0|0] "g" Vector__XXX
 SG_ IMU_Yaw_Rate : 0|16@1+ (0.005,-163.84) [0|0] "deg/s" Vector__XXX

CM_ BO_ 380 "Z accel";
CM_ BO_ 376 "Roll rate, X accel";
CM_ BO_ 372 "Yaw rate, Y accel";
BA_DEF_  "BusType" STRING ;
BA_DEF_DEF_  "BusType" "";
BA_ "BusType" "CAN";
